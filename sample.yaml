## sample.yaml
```yaml
sample:
  name: Bluetooth HCI UART
  description: Allows Zephyr to provide Bluetooth connectivity via UART
tests:
  sample.bluetooth.hci_uart.nrf54l15.all:
    harness: bluetooth
    platform_allow: nrf54l15dk/nrf54l15/cpuapp
    integration_platforms:
      - nrf54l15dk/nrf54l15/cpuapp
    extra_args:
      - CONFIG=prj_auracaster.config
    tags:
      - uart
      - bluetooth
  
  sample.bluetooth.hci_uart.nrf52840.all:
    harness: bluetooth
    platform_allow: nrf52840dongle/nrf52840
    integration_platforms:
      - nrf52840dongle/nrf52840
    extra_args:
      - CONFIG=prj_auracaster.config
      - OVERLAY_CONFIG=boards/nrf52840dongle_nrf52840.conf
    tags:
      - uart
      - bluetooth
```
